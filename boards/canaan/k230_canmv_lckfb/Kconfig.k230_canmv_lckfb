## boards/canaan/k230_canmv_lckfb/Kconfig.k230_canmv_lckfb
```kconfig
# Copyright (c) 2024 Junhui Liu <liujh2818@outlook.com>
# Copyright (c) 2026 Zhian Liang <liangzhan5dev@gmail.com>
# SPDX-License-Identifier: Apache-2.0

config BOARD_K230_CANMV_LCKFB
	select SOC_CANAAN_K230
```

## boards/canaan/k230_canmv_lckfb/board.yml
```yaml
# Copyright (c) 2024 Junhui Liu <liujh2818@outlook.com>
# Copyright (c) 2026 Zhian Liang <liangzhan5dev@gmail.com>
# SPDX-License-Identifier: Apache-2.0

board:
  name: k230_canmv_lckfb
  full_name: Canaan K230 CanMV LCKFB
  vendor: canaan
  socs:
    - name: k230
```
